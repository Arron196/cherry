typedef struct
{
  uint32_t codepoint;
  uint8_t bitmap[32];
} OLED_Hanzi16Glyph;
static const OLED_Hanzi16Glyph oled_hanzi16_glyphs[] = {
  {0x6A31UL, {0x10, 0x00, 0x13, 0xFE, 0x12, 0x72, 0x7F, 0xFE, 0x33, 0x7A, 0x33, 0x7A, 0x3B, 0x18, 0x7E, 0x94, 0x52, 0x32, 0x52, 0xC4, 0x17, 0xFE, 0x11, 0x90, 0x10, 0x70, 0x13, 0xCC, 0x02, 0x00, 0x00, 0x00}}, /* 樱 */
  {0x6843UL, {0x10, 0xD0, 0x10, 0xD0, 0x12, 0xD2, 0x7B, 0xD6, 0x7D, 0xDC, 0x11, 0xD8, 0x38, 0xD0, 0x3C, 0xD8, 0x73, 0xDE, 0x52, 0xD2, 0x50, 0x90, 0x11, 0x92, 0x13, 0x12, 0x16, 0x1E, 0x00, 0x00, 0x00, 0x00}}, /* 桃 */
  {0x6EAFUL, {0x00, 0x00, 0x04, 0xC0, 0x36, 0x9E, 0x12, 0x92, 0x0F, 0xF2, 0x43, 0x1E, 0x75, 0x56, 0x0D, 0x52, 0x0D, 0x52, 0x3D, 0xDE, 0x3F, 0xF6, 0x23, 0x72, 0x62, 0x22, 0x66, 0x62, 0x4C, 0xCE, 0x08, 0x00}}, /* 溯 */
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  {0x6001UL, {0x00, 0x00, 0x01, 0x00, 0x03, 0x00, 0x7F, 0xFE, 0x07, 0x60, 0x06, 0x60, 0x0E, 0x30, 0x1B, 0x18, 0x71, 0x0E, 0x60, 0x00, 0x01, 0x88, 0x34, 0x8C, 0x24, 0x06, 0x64, 0x12, 0x47, 0xF0, 0x00, 0x00}}, /* 态 */
};
